/dts-v1/;

/ {
    #address-cells = <0x02>;
    #size-cells = <0x02>;

    test-props {
        u32-prop = <0x12345678>;
        u64-prop = <0x11223344 0x55667788>;
        str-prop = "hello world";
        str-list-prop = "first", "second", "third";
    };

    standard-props@1 {
        #address-cells = <0x08>;
        #size-cells = <0x04>;
        reg = <0x12345678 0x3000 0x00 0x20 0x00 0xfe00 0x00 0x100>;
        compatible = "abc,def", "some,other";
        status = "fail";
        model = "Some Model";
        phandle = <0x1234>;
        virtual-reg = <0xabcd>;
        dma-coherent;
    };
};
